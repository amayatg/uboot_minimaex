## board/kws/mx7dminimax/Kconfig
```kconfig
if TARGET_MX7DMINIMAX

config SYS_BOARD
	default "mx7dminimax"

config SYS_VENDOR
	default "kws"

config SYS_SOC
	default "mx7"

config SYS_CONFIG_NAME
	default "mx7dminimax"

endif
```

## configs/mx7dminimax_defconfig
```kconfig
CONFIG_ARM=y
CONFIG_ARCH_MX7=y
CONFIG_TARGET_MX7DMINIMAX=y
CONFIG_IMX_RDC=y
CONFIG_IMX_BOOTAUX=y
CONFIG_SYS_EXTRA_OPTIONS="IMX_CONFIG=board/kws/mx7dminimax/imximage.cfg"
CONFIG_CMD_GPIO=y
CONFIG_CMD_DHCP=y
CONFIG_CMD_PING=y
CONFIG_LOCALVERSION=" KWS-Minimaex-v1.0"
CONFIG_LOCALVERSION_AUTO=n
```
